/*
 * KCB 運行管理システム
 * ブートスクリーン + メイン画面（ダイヤルメニュー）
 * 
 * ブートスクリーン → 3秒後 → メイン画面へ遷移
 * メイン画面: タッチ左右でメニュー切替、ダイヤル回転対応予定
 */

#include <M5Unified.h>

// ============================================================
// ビットマップアイコンデータ（PNG, PROGMEM）
// ============================================================

// --- car icon (active, 40x40) ---
static const uint8_t icon_car_active[] PROGMEM = {
  0x89, 0x50, 0x4e, 0x47, 0x0d, 0x0a, 0x1a, 0x0a, 0x00, 0x00, 0x00, 0x0d, 0x49, 0x48, 0x44, 0x52,
  0x00, 0x00, 0x00, 0x28, 0x00, 0x00, 0x00, 0x28, 0x08, 0x06, 0x00, 0x00, 0x00, 0x8c, 0xfe, 0xb8,
  0x6d, 0x00, 0x00, 0x00, 0xcc, 0x49, 0x44, 0x41, 0x54, 0x78, 0x9c, 0xed, 0x96, 0xd1, 0x0d, 0xc3,
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  0x44, 0xae, 0x42, 0x60, 0x82,
};
static const size_t icon_car_active_len = 261;

// --- car icon (inactive, 28x28) ---
static const uint8_t icon_car_inactive[] PROGMEM = {
  0x89, 0x50, 0x4e, 0x47, 0x0d, 0x0a, 0x1a, 0x0a, 0x00, 0x00, 0x00, 0x0d, 0x49, 0x48, 0x44, 0x52,
  0x00, 0x00, 0x00, 0x1c, 0x00, 0x00, 0x00, 0x1c, 0x08, 0x06, 0x00, 0x00, 0x00, 0x72, 0x0d, 0xdf,
  0x94, 0x00, 0x00, 0x00, 0x8b, 0x49, 0x44, 0x41, 0x54, 0x78, 0x9c, 0x63, 0x60, 0x18, 0x05, 0xa3,
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  0xae, 0x42, 0x60, 0x82,
};
static const size_t icon_car_inactive_len = 196;

// --- gps icon (active, 40x40) ---
static const uint8_t icon_gps_active[] PROGMEM = {
  0x89, 0x50, 0x4e, 0x47, 0x0d, 0x0a, 0x1a, 0x0a, 0x00, 0x00, 0x00, 0x0d, 0x49, 0x48, 0x44, 0x52,
  0x00, 0x00, 0x00, 0x28, 0x00, 0x00, 0x00, 0x28, 0x08, 0x06, 0x00, 0x00, 0x00, 0x8c, 0xfe, 0xb8,
  0x6d, 0x00, 0x00, 0x00, 0xc6, 0x49, 0x44, 0x41, 0x54, 0x78, 0x9c, 0xed, 0x97, 0x5b, 0x12, 0x40,
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  0xcd, 0xc9, 0xff, 0x00, 0x00, 0x00, 0x00, 0x49, 0x45, 0x4e, 0x44, 0xae, 0x42, 0x60, 0x82,
};
static const size_t icon_gps_active_len = 255;

// --- gps icon (inactive, 28x28) ---
static const uint8_t icon_gps_inactive[] PROGMEM = {
  0x89, 0x50, 0x4e, 0x47, 0x0d, 0x0a, 0x1a, 0x0a, 0x00, 0x00, 0x00, 0x0d, 0x49, 0x48, 0x44, 0x52,
  0x00, 0x00, 0x00, 0x1c, 0x00, 0x00, 0x00, 0x1c, 0x08, 0x06, 0x00, 0x00, 0x00, 0x72, 0x0d, 0xdf,
  0x94, 0x00, 0x00, 0x00, 0x80, 0x49, 0x44, 0x41, 0x54, 0x78, 0x9c, 0x63, 0x60, 0x18, 0x05, 0x43,
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  0x00, 0x49, 0x45, 0x4e, 0x44, 0xae, 0x42, 0x60, 0x82,
};
static const size_t icon_gps_inactive_len = 185;

// --- obd icon (active, 40x40) ---
static const uint8_t icon_obd_active[] PROGMEM = {
  0x89, 0x50, 0x4e, 0x47, 0x0d, 0x0a, 0x1a, 0x0a, 0x00, 0x00, 0x00, 0x0d, 0x49, 0x48, 0x44, 0x52,
  0x00, 0x00, 0x00, 0x28, 0x00, 0x00, 0x00, 0x28, 0x08, 0x06, 0x00, 0x00, 0x00, 0x8c, 0xfe, 0xb8,
  0x6d, 0x00, 0x00, 0x00, 0x82, 0x49, 0x44, 0x41, 0x54, 0x78, 0x9c, 0xed, 0xd5, 0x51, 0x0e, 0x40,
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  0x00, 0x00, 0x00, 0x49, 0x45, 0x4e, 0x44, 0xae, 0x42, 0x60, 0x82,
};
static const size_t icon_obd_active_len = 187;

// --- obd icon (inactive, 28x28) ---
static const uint8_t icon_obd_inactive[] PROGMEM = {
  0x89, 0x50, 0x4e, 0x47, 0x0d, 0x0a, 0x1a, 0x0a, 0x00, 0x00, 0x00, 0x0d, 0x49, 0x48, 0x44, 0x52,
  0x00, 0x00, 0x00, 0x1c, 0x00, 0x00, 0x00, 0x1c, 0x08, 0x06, 0x00, 0x00, 0x00, 0x72, 0x0d, 0xdf,
  0x94, 0x00, 0x00, 0x00, 0x6c, 0x49, 0x44, 0x41, 0x54, 0x78, 0x9c, 0xed, 0x91, 0x51, 0x0e, 0xc0,
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  0x44, 0xae, 0x42, 0x60, 0x82,
};
static const size_t icon_obd_inactive_len = 165;

// --- driver icon (active, 40x40) ---
static const uint8_t icon_driver_active[] PROGMEM = {
  0x89, 0x50, 0x4e, 0x47, 0x0d, 0x0a, 0x1a, 0x0a, 0x00, 0x00, 0x00, 0x0d, 0x49, 0x48, 0x44, 0x52,
  0x00, 0x00, 0x00, 0x28, 0x00, 0x00, 0x00, 0x28, 0x08, 0x06, 0x00, 0x00, 0x00, 0x8c, 0xfe, 0xb8,
  0x6d, 0x00, 0x00, 0x00, 0xce, 0x49, 0x44, 0x41, 0x54, 0x78, 0x9c, 0xed, 0x97, 0x4b, 0x0e, 0x85,
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  0x45, 0x4e, 0x44, 0xae, 0x42, 0x60, 0x82,
};
static const size_t icon_driver_active_len = 263;

// --- driver icon (inactive, 28x28) ---
static const uint8_t icon_driver_inactive[] PROGMEM = {
  0x89, 0x50, 0x4e, 0x47, 0x0d, 0x0a, 0x1a, 0x0a, 0x00, 0x00, 0x00, 0x0d, 0x49, 0x48, 0x44, 0x52,
  0x00, 0x00, 0x00, 0x1c, 0x00, 0x00, 0x00, 0x1c, 0x08, 0x06, 0x00, 0x00, 0x00, 0x72, 0x0d, 0xdf,
  0x94, 0x00, 0x00, 0x00, 0x7e, 0x49, 0x44, 0x41, 0x54, 0x78, 0x9c, 0x63, 0x60, 0x18, 0x05, 0xa3,
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  0x45, 0x4e, 0x44, 0xae, 0x42, 0x60, 0x82,
};
static const size_t icon_driver_inactive_len = 183;

// --- gear icon (active, 40x40) ---
static const uint8_t icon_gear_active[] PROGMEM = {
  0x89, 0x50, 0x4e, 0x47, 0x0d, 0x0a, 0x1a, 0x0a, 0x00, 0x00, 0x00, 0x0d, 0x49, 0x48, 0x44, 0x52,
  0x00, 0x00, 0x00, 0x28, 0x00, 0x00, 0x00, 0x28, 0x08, 0x06, 0x00, 0x00, 0x00, 0x8c, 0xfe, 0xb8,
  0x6d, 0x00, 0x00, 0x01, 0x1a, 0x49, 0x44, 0x41, 0x54, 0x78, 0x9c, 0xed, 0x97, 0x41, 0x0e, 0x84,
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  0x42, 0x60, 0x82,
};
static const size_t icon_gear_active_len = 339;

// --- gear icon (inactive, 28x28) ---
static const uint8_t icon_gear_inactive[] PROGMEM = {
  0x89, 0x50, 0x4e, 0x47, 0x0d, 0x0a, 0x1a, 0x0a, 0x00, 0x00, 0x00, 0x0d, 0x49, 0x48, 0x44, 0x52,
  0x00, 0x00, 0x00, 0x1c, 0x00, 0x00, 0x00, 0x1c, 0x08, 0x06, 0x00, 0x00, 0x00, 0x72, 0x0d, 0xdf,
  0x94, 0x00, 0x00, 0x00, 0xaa, 0x49, 0x44, 0x41, 0x54, 0x78, 0x9c, 0xed, 0x95, 0xcd, 0x09, 0x80,
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  0x42, 0x60, 0x82,
};
static const size_t icon_gear_inactive_len = 227;

// ============================================================
// アイコンデータ参照テーブル
// ============================================================
struct IconData {
  const uint8_t* active;
  size_t activeLen;
  const uint8_t* inactive;
  size_t inactiveLen;
};

static const IconData icons[5] = {
  { icon_car_active,    icon_car_active_len,    icon_car_inactive,    icon_car_inactive_len },
  { icon_gps_active,    icon_gps_active_len,    icon_gps_inactive,    icon_gps_inactive_len },
  { icon_obd_active,    icon_obd_active_len,    icon_obd_inactive,    icon_obd_inactive_len },
  { icon_driver_active, icon_driver_active_len, icon_driver_inactive, icon_driver_inactive_len },
  { icon_gear_active,   icon_gear_active_len,   icon_gear_inactive,   icon_gear_inactive_len },
};

// ============================================================
// 色定義
// ============================================================
#define COL_BG        0x0208    // 暗いグリーンブラック
#define COL_GREEN     0x4F66    // メインのグリーン (#4ade80相当)
#define COL_GREEN_DIM 0x1B22    // 暗めのグリーン
#define COL_DARK      0x0A41    // 背景グラデ用
#define COL_GRAY_DIM  0x3186    // 薄いグレー（未初期化）
#define COL_WHITE_DIM 0x6B4D    // 薄い白

// メイン画面用追加色
#define COL_CYAN      0x07FF
#define COL_ORANGE    0xFD20
#define COL_PURPLE    0x781F
#define COL_GRAY      0x7BEF
#define COL_DIM_LINE  0x2104    // 非常に薄い白

// ============================================================
// 画面定数
// ============================================================
#define CX 120
#define CY 120
#define SCREEN_R 120

// メーター中心（少し上寄せ）
#define GAUGE_CX 120
#define GAUGE_CY 100
#define GAUGE_R  65

// ============================================================
// モジュール定義（ブート画面用）
// ============================================================
#define MOD_GPS  0
#define MOD_OBD  1
#define MOD_NFC  2
#define MOD_WIFI 3
#define MOD_COUNT 4

const char* modNames[MOD_COUNT] = { "GPS", "OBD", "NFC", "WiFi" };
bool modReady[MOD_COUNT] = { false, false, false, false };

const int modX[MOD_COUNT] = { 52, 96, 140, 184 };
const int modY[MOD_COUNT] = { 200, 200, 200, 200 };
const int dotR = 4;

// ============================================================
// メニュー定義（メイン画面用）
// ============================================================
#define MENU_COUNT 5

struct MenuItem {
  const char* label;
  uint16_t color;
};

static const MenuItem menuItems[MENU_COUNT] = {
  { "ステータス",   COL_GREEN  },
  { "GPS情報",     COL_CYAN   },
  { "OBD2",       COL_ORANGE },
  { "ドライバー",   COL_PURPLE },
  { "設定",        COL_GRAY   },
};

// アイコン配置角度: 10, 11, 12, 1, 2 時の位置
static const float iconAngles[MENU_COUNT] = { -150.0, -120.0, -90.0, -60.0, -30.0 };
static const int ICON_ORBIT_R = 82;

// ============================================================
// アプリケーション状態
// ============================================================
enum AppState {
  STATE_BOOT,
  STATE_BOOT_GAUGE,
  STATE_TRANSITION,
  STATE_MAIN
};

AppState appState = STATE_BOOT;
int selectedIndex = 0;
bool needsRedraw = true;
unsigned long transitionStart = 0;

// ============================================================
// ブート画面描画関数（元のコードをそのまま保持）
// ============================================================

void drawBackground() {
  M5.Display.fillScreen(COL_BG);
  for (int r = SCREEN_R; r > 20; r -= 2) {
    uint8_t g = map(r, 20, SCREEN_R, 20, 4);
    uint16_t col = M5.Display.color565(0, g, g / 3);
    M5.Display.drawCircle(CX, CY, r, col);
  }
}

void drawHexGrid() {
  uint16_t col = M5.Display.color565(10, 40, 20);
  const int hexPoints[][2] = {
    {120, 20}, {150, 37}, {150, 71}, {120, 88}, {90, 71}, {90, 37}
  };
  for (int i = 0; i < 6; i++) {
    int next = (i + 1) % 6;
    M5.Display.drawLine(hexPoints[i][0], hexPoints[i][1],
                        hexPoints[next][0], hexPoints[next][1], col);
  }
  const int hex2[][2] = {
    {120, 90}, {150, 107}, {150, 141}, {120, 158}, {90, 141}, {90, 107}
  };
  for (int i = 0; i < 6; i++) {
    int next = (i + 1) % 6;
    M5.Display.drawLine(hex2[i][0], hex2[i][1],
                        hex2[next][0], hex2[next][1], col);
  }
}

void drawCornerBrackets() {
  uint16_t col = M5.Display.color565(15, 60, 30);
  int len = 10;
  int margin = 28;
  M5.Display.drawLine(margin, margin, margin + len, margin, col);
  M5.Display.drawLine(margin, margin, margin, margin + len, col);
  M5.Display.drawLine(240 - margin, margin, 240 - margin - len, margin, col);
  M5.Display.drawLine(240 - margin, margin, 240 - margin, margin + len, col);
  M5.Display.drawLine(margin, 240 - margin, margin + len, 240 - margin, col);
  M5.Display.drawLine(margin, 240 - margin, margin, 240 - margin - len, col);
  M5.Display.drawLine(240 - margin, 240 - margin, 240 - margin - len, 240 - margin, col);
  M5.Display.drawLine(240 - margin, 240 - margin, 240 - margin, 240 - margin - len, col);
}

void drawGaugeBackground() {
  for (int deg = -210; deg <= 30; deg += 2) {
    float rad = deg * PI / 180.0;
    int x = GAUGE_CX + (int)(GAUGE_R * cos(rad));
    int y = GAUGE_CY + (int)(GAUGE_R * sin(rad));
    M5.Display.drawPixel(x, y, COL_GREEN_DIM);
    x = GAUGE_CX + (int)((GAUGE_R - 1) * cos(rad));
    y = GAUGE_CY + (int)((GAUGE_R - 1) * sin(rad));
    M5.Display.drawPixel(x, y, COL_GREEN_DIM);
  }
  for (int i = 0; i < 7; i++) {
    int deg = -210 + i * 40;
    float rad = deg * PI / 180.0;
    int x1 = GAUGE_CX + (int)(GAUGE_R * cos(rad));
    int y1 = GAUGE_CY + (int)(GAUGE_R * sin(rad));
    int x2 = GAUGE_CX + (int)((GAUGE_R - 7) * cos(rad));
    int y2 = GAUGE_CY + (int)((GAUGE_R - 7) * sin(rad));
    M5.Display.drawLine(x1, y1, x2, y2, COL_GREEN_DIM);
  }
  M5.Display.drawCircle(GAUGE_CX, GAUGE_CY, 28, COL_GREEN_DIM);
}

void drawGpsPin(uint16_t col) {
  int cx = GAUGE_CX;
  int cy = GAUGE_CY;
  M5.Display.drawCircle(cx, cy - 6, 8, col);
  M5.Display.drawLine(cx - 6, cy - 1, cx, cy + 10, col);
  M5.Display.drawLine(cx + 6, cy - 1, cx, cy + 10, col);
  M5.Display.drawCircle(cx, cy - 6, 3, col);
}

void drawKCBText() {
  M5.Display.setTextColor(COL_GREEN);
  M5.Display.setTextDatum(top_center);
  M5.Display.setFont(&fonts::FreeSansBold18pt7b);
  M5.Display.drawString("KCB", CX, 140);
  M5.Display.setFont(&fonts::lgfxJapanGothic_16);
  M5.Display.setTextColor(M5.Display.color565(40, 140, 70));
  M5.Display.drawString("運行管理システム", CX, 177);
}

void drawModuleIndicators() {
  M5.Display.setFont(&fonts::Font0);
  M5.Display.setTextSize(1);
  M5.Display.setTextDatum(middle_left);
  for (int i = 0; i < MOD_COUNT; i++) {
    int x = modX[i];
    int y = modY[i];
    if (modReady[i]) {
      M5.Display.fillCircle(x, y, dotR, COL_GREEN);
    } else {
      M5.Display.drawCircle(x, y, dotR, COL_GRAY_DIM);
    }
  }
  M5.Display.setTextDatum(top_center);
  M5.Display.setFont(&fonts::Font0);
  M5.Display.setTextSize(1);
  for (int i = 0; i < MOD_COUNT; i++) {
    uint16_t col = modReady[i] ? COL_GREEN : COL_GRAY_DIM;
    M5.Display.setTextColor(col);
    M5.Display.drawString(modNames[i], modX[i], modY[i] + dotR + 3);
  }
}

void drawGaugeActive() {
  for (int deg = -210; deg <= -130; deg += 2) {
    float rad = deg * PI / 180.0;
    for (int t = 0; t < 3; t++) {
      int x = GAUGE_CX + (int)((GAUGE_R - t) * cos(rad));
      int y = GAUGE_CY + (int)((GAUGE_R - t) * sin(rad));
      M5.Display.drawPixel(x, y, COL_GREEN);
    }
    if (deg % 10 == 0) delay(5);
  }
  float needleDeg = -130.0 * PI / 180.0;
  int nx = GAUGE_CX + (int)(50 * cos(needleDeg));
  int ny = GAUGE_CY + (int)(50 * sin(needleDeg));
  M5.Display.drawLine(GAUGE_CX, GAUGE_CY, nx, ny, COL_GREEN);
  M5.Display.drawLine(GAUGE_CX + 1, GAUGE_CY, nx + 1, ny, COL_GREEN);
  M5.Display.fillCircle(GAUGE_CX, GAUGE_CY, 4, COL_GREEN);
  drawGpsPin(COL_GREEN);
}

void drawBootScreen() {
  for (int i = 0; i < MOD_COUNT; i++) {
    modReady[i] = false;
  }
  drawBackground();
  drawHexGrid();
  drawCornerBrackets();
  drawGaugeBackground();
  drawKCBText();
  drawModuleIndicators();
}

void setModuleReady(int moduleIndex) {
  if (moduleIndex < 0 || moduleIndex >= MOD_COUNT) return;
  modReady[moduleIndex] = true;
  int x = modX[moduleIndex];
  int y = modY[moduleIndex];
  M5.Display.fillCircle(x, y, dotR + 1, COL_BG);
  M5.Display.fillCircle(x, y, dotR, COL_GREEN);
  M5.Display.setFont(&fonts::Font0);
  M5.Display.setTextSize(1);
  M5.Display.setTextDatum(top_center);
  M5.Display.setTextColor(COL_GREEN, COL_BG);
  M5.Display.drawString(modNames[moduleIndex], x, y + dotR + 3);
}

// ============================================================
// メイン画面描画関数
// ============================================================

void drawMainScreen() {
  // 背景（ブート画面と同系色のダークグリーン）
  M5.Display.fillScreen(COL_BG);
  
  // 中心に向かって少し明るくする放射状グラデ
  for (int r = SCREEN_R; r > 40; r -= 3) {
    uint8_t g = map(r, 40, SCREEN_R, 12, 2);
    uint16_t col = M5.Display.color565(0, g, g / 3);
    M5.Display.drawCircle(CX, CY, r, col);
  }
  
  // アイコン軌道の弧（薄い線）
  for (int deg = -155; deg <= -25; deg++) {
    float rad = deg * PI / 180.0;
    int x = CX + (int)(ICON_ORBIT_R * cos(rad));
    int y = CY + (int)(ICON_ORBIT_R * sin(rad));
    M5.Display.drawPixel(x, y, COL_DIM_LINE);
  }
  
  // メニューアイコン描画
  drawMenuIcons();
  
  // ページコンテンツ描画
  switch (selectedIndex) {
    case 0: drawStatusPage();  break;
    case 1: drawGpsPage();     break;
    case 2: drawObdPage();     break;
    case 3: drawDriverPage();  break;
    case 4: drawConfigPage();  break;
  }
  
  // 下部ヒント
  M5.Display.setFont(&fonts::lgfxJapanGothicP_12);
  M5.Display.setTextColor(COL_DIM_LINE);
  M5.Display.setTextDatum(middle_center);
  M5.Display.drawString("< タッチで切替 >", CX, 225);
}

void drawMenuIcons() {
  for (int i = 0; i < MENU_COUNT; i++) {
    float rad = iconAngles[i] * PI / 180.0;
    int ix = CX + (int)(ICON_ORBIT_R * cos(rad));
    int iy = CY + (int)(ICON_ORBIT_R * sin(rad));
    
    bool active = (i == selectedIndex);
    int iconHalf = active ? 20 : 14;
    
    if (active) {
      // グロー効果（アクティブアイコンの背景光）
      uint16_t glowCol = menuItems[i].color;
      // 薄い円でグロー表現
      for (int r = iconHalf + 6; r > iconHalf + 2; r--) {
        M5.Display.drawCircle(ix, iy, r, M5.Display.color565(
          ((glowCol >> 11) & 0x1F) << 1,
          ((glowCol >> 5) & 0x3F) >> 2,
          (glowCol & 0x1F) >> 2
        ));
      }
      // アクティブ背景円
      M5.Display.fillCircle(ix, iy, iconHalf + 2, M5.Display.color565(8, 16, 8));
      M5.Display.drawCircle(ix, iy, iconHalf + 2, menuItems[i].color);
    } else {
      // 非アクティブ背景円
      M5.Display.fillCircle(ix, iy, iconHalf + 2, M5.Display.color565(4, 8, 4));
    }
    
    // PNGアイコン描画
    const uint8_t* iconData = active ? icons[i].active : icons[i].inactive;
    size_t iconLen = active ? icons[i].activeLen : icons[i].inactiveLen;
    M5.Display.drawPng(iconData, iconLen, ix - iconHalf, iy - iconHalf);
  }
}

// ============================================================
// ページコンテンツ
// ============================================================

void drawStatusPage() {
  M5.Display.setFont(&fonts::lgfxJapanGothicP_20);
  M5.Display.setTextColor(COL_GREEN);
  M5.Display.setTextDatum(middle_center);
  M5.Display.drawString("待機中", CX, CY);
  
  M5.Display.setFont(&fonts::lgfxJapanGothicP_12);
  M5.Display.setTextColor(COL_GREEN_DIM);
  M5.Display.drawString("運転者: 未登録", CX, CY + 22);
  M5.Display.drawString("運行: 停止", CX, CY + 38);
}

void drawGpsPage() {
  M5.Display.setFont(&fonts::lgfxJapanGothicP_16);
  M5.Display.setTextColor(COL_CYAN);
  M5.Display.setTextDatum(middle_center);
  M5.Display.drawString("GPS情報", CX, CY - 10);
  
  M5.Display.setFont(&fonts::lgfxJapanGothicP_12);
  M5.Display.setTextColor(0x0410);
  M5.Display.drawString("衛星: 受信待ち", CX, CY + 10);
  M5.Display.drawString("最遠地点: ---", CX, CY + 26);
  M5.Display.drawString("距離: ---", CX, CY + 42);
}

void drawObdPage() {
  M5.Display.setFont(&fonts::lgfxJapanGothicP_16);
  M5.Display.setTextColor(COL_ORANGE);
  M5.Display.setTextDatum(middle_center);
  M5.Display.drawString("OBD2", CX, CY - 10);
  
  M5.Display.setFont(&fonts::lgfxJapanGothicP_12);
  M5.Display.setTextColor(0x7A00);
  M5.Display.drawString("接続: 未接続", CX, CY + 10);
  M5.Display.drawString("走行距離: ---", CX, CY + 26);
  M5.Display.drawString("PID 0xA6: 未確認", CX, CY + 42);
}

void drawDriverPage() {
  M5.Display.setFont(&fonts::lgfxJapanGothicP_16);
  M5.Display.setTextColor(COL_PURPLE);
  M5.Display.setTextDatum(middle_center);
  M5.Display.drawString("ドライバー", CX, CY - 10);
  
  M5.Display.setFont(&fonts::lgfxJapanGothicP_12);
  M5.Display.setTextColor(0x380F);
  M5.Display.drawString("カード待機中", CX, CY + 10);
  M5.Display.drawString("カードをタッチ", CX, CY + 30);
}

void drawConfigPage() {
  M5.Display.setFont(&fonts::lgfxJapanGothicP_16);
  M5.Display.setTextColor(COL_GRAY);
  M5.Display.setTextDatum(middle_center);
  M5.Display.drawString("設定", CX, CY - 10);
  
  M5.Display.setFont(&fonts::lgfxJapanGothicP_12);
  M5.Display.setTextColor(0x3186);
  M5.Display.drawString("WiFi: 未接続", CX, CY + 10);
  M5.Display.drawString("会社座標: 設定済", CX, CY + 26);
  M5.Display.drawString("判定距離: 100m", CX, CY + 42);
}

// ============================================================
// 入力処理
// ============================================================
void handleInput() {
  auto t = M5.Touch.getDetail();
  
  // タッチ: 左半分=前、右半分=次
  if (t.wasPressed()) {
    if (t.x < CX) {
      if (selectedIndex > 0) {
        selectedIndex--;
        needsRedraw = true;
      }
    } else {
      if (selectedIndex < MENU_COUNT - 1) {
        selectedIndex++;
        needsRedraw = true;
      }
    }
  }
  
  // ボタン押下: フィードバック
  if (M5.BtnA.wasPressed()) {
    M5.Display.fillCircle(CX, CY, 30, menuItems[selectedIndex].color);
    delay(100);
    needsRedraw = true;
  }
}

// ============================================================
// Setup
// ============================================================
void setup() {
  auto cfg = M5.config();
  M5.begin(cfg);
  
  M5.Display.setRotation(0);
  M5.Display.setBrightness(80);
  
  // ========================================
  // ブートスクリーン
  // ========================================
  drawBootScreen();
  delay(500);
  
  // 各モジュール初期化（後で実際の初期化処理に置き換え）
  delay(400);
  setModuleReady(MOD_GPS);
  delay(400);
  setModuleReady(MOD_OBD);
  delay(400);
  setModuleReady(MOD_NFC);
  delay(400);
  setModuleReady(MOD_WIFI);
  
  // メーター起動演出
  delay(300);
  drawGaugeActive();
  
  // 3秒待機（ブート画面表示時間確保）
  delay(700);  // 上記の処理時間を合わせて約3秒
  
  // メイン画面へ遷移
  appState = STATE_MAIN;
  needsRedraw = true;
}

// ============================================================
// Main Loop
// ============================================================
void loop() {
  M5.update();
  
  if (appState == STATE_MAIN) {
    handleInput();
    if (needsRedraw) {
      drawMainScreen();
      needsRedraw = false;
    }
  }
}
